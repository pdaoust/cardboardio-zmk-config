## config/boards/arm/elite_pi_rp2040_clone/Kconfig.board
```kconfig
# Copyright (c) 2021 Pete Johanson
# SPDX-License-Identifier: Apache-2.0

config BOARD_ELITE_PI_RP2040_CLONE
	bool "Elite-Pi clone RP2040 Board"
	depends on SOC_RP2040
```

## config/boards/arm/elite_pi_rp2040_clone/Kconfig.defconfig
```kconfig
# Copyright (c) 2021 Pete Johanson
# SPDX-License-Identifier: Apache-2.0

if BOARD_ELITE_PI_RP2040_CLONE

config BOARD
	default "elite_pi_rp2040_clone"

config RP2_FLASH_W25Q080
	default y

endif # BOARD_ELITE_PI_RP2040_CLONE
```

## config/boards/arm/weird_rp2040_clone/Kconfig.board
```kconfig
# Copyright (c) 2021 Pete Johanson
# SPDX-License-Identifier: Apache-2.0

config BOARD_WEIRD_RP2040_CLONE
	bool "Weird clone RP2040 Board"
	depends on SOC_RP2040
```

## config/boards/arm/weird_rp2040_clone/Kconfig.defconfig
```kconfig
# Copyright (c) 2021 Pete Johanson
# SPDX-License-Identifier: Apache-2.0

if BOARD_WEIRD_RP2040_CLONE

config BOARD
	default "weird_rp2040_clone"

config RP2_FLASH_W25Q080
	default y

endif # BOARD_WEIRD_RP2040_CLONE
```

## config/boards/shields/cardboardio/Kconfig.defconfig
```kconfig
# Copyright (c) 2020 The ZMK Contributors
# SPDX-License-Identifier: MIT

if SHIELD_CARDBOARDIO_RIGHT

config ZMK_KEYBOARD_NAME
    default "Cardboardio"

config ZMK_SPLIT_ROLE_CENTRAL
    default y

endif

if SHIELD_CARDBOARDIO_LEFT || SHIELD_CARDBOARDIO_RIGHT

config ZMK_SPLIT
    default y

endif
```

## config/boards/shields/cardboardio/Kconfig.shield
```kconfig
# Copyright (c) 2020 The ZMK Contributors
# SPDX-License-Identifier: MIT

config SHIELD_CARDBOARDIO_LEFT
    def_bool $(shields_list_contains,cardboardio_left)
    select SPI

config SHIELD_CARDBOARDIO_RIGHT
    def_bool $(shields_list_contains,cardboardio_right)
    select SPI
```
