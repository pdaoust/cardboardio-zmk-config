/*
 * Copyright (c) 2020 The ZMK Contributors
 *
 * SPDX-License-Identifier: MIT
 */

#include "cardboardio.dtsi"

&default_transform {
    col-offset = <-7>;
};

&left_thumb_encoder {
    status = "okay";
};

&lower_encoder {
    status = "okay";
};

&upper_encoder {
    status = "okay";
};